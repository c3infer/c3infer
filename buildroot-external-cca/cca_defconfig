## buildroot-external-cca/cca_defconfig
```kconfig
BR2_aarch64=y
BR2_ARM64_PAGE_SIZE_64K=y
BR2_TOOLCHAIN_BUILDROOT_GLIBC=y
BR2_TOOLCHAIN_BUILDROOT_CXX=y
BR2_TOOLCHAIN_BUILDROOT_FORTRAN=y
BR2_GCC_ENABLE_OPENMP=y
BR2_SYSTEM_BIN_SH_BASH=y
BR2_PACKAGE_BUSYBOX_SHOW_OTHERS=y
BR2_PACKAGE_ZLIB=y
# BR2_PACKAGE_URANDOM_SCRIPTS is not set
BR2_TARGET_ROOTFS_CPIO=y
BR2_TARGET_ROOTFS_CPIO_GZIP=y
BR2_TARGET_ROOTFS_EXT2=y
BR2_TARGET_ROOTFS_EXT2_4=y
BR2_TARGET_ROOTFS_EXT2_LABEL="rootfs"
BR2_TARGET_ROOTFS_EXT2_SIZE="256M"
BR2_LINUX_KERNEL=n

# BR2_TARGET_ROOTFS_TAR is not set

BR2_SYSTEM_DHCP="eth0"

BR2_PACKAGE_CHRONY=y

BR2_PACKAGE_KVMTOOL_CCA=y
BR2_PACKAGE_QEMU_CCA=y
BR2_PACKAGE_QEMU_CCA_SYSTEM=y
BR2_PACKAGE_QEMU_CCA_BLOBS=n
BR2_PACKAGE_QEMU_CCA_SLIRP=y
BR2_PACKAGE_QEMU_CCA_FDT=y
BR2_PACKAGE_QEMU_CCA_CHOOSE_TARGETS=y
BR2_PACKAGE_QEMU_CCA_TARGET_AARCH64=y
BR2_PACKAGE_QEMU_CCA_TRACING=y

BR2_PACKAGE_CCA_REALM_MEASUREMENTS=y
BR2_PACKAGE_CCA_WORKLOAD_ATTESTATION=y
BR2_PACKAGE_KEYBROKER_DEMO=y

BR2_ROOTFS_POST_BUILD_SCRIPT="$(BR2_EXTERNAL_LINARO_CCA_PATH)/scripts/post-build.sh"

# Try to generate the same image every time, so we only need to provision
# the verifier with an initrd hash once.
BR2_REPRODUCIBLE=y

BR2_GLOBAL_PATCH_DIR="$(BR2_EXTERNAL_LINARO_CCA_PATH)/patches/"

BR2_ROOTFS_OVERLAY="$(BR2_EXTERNAL_LINARO_CCA_PATH)/overlay/realm1_overlay"
```
